## app/boards/solderotto/solderotto_defconfig
```kconfig
# SPDX-License-Identifier: Apache-2.0

# enable GPIO
CONFIG_GPIO=y

# Enable Clocks
CONFIG_CLOCK_CONTROL=y

# Enable MPU
CONFIG_ARM_MPU=y

# Enable HW stack protection
CONFIG_HW_STACK_PROTECTION=y

# enable pin controller
CONFIG_PINCTRL=y

# enable DMA
# CONFIG_DMA=y

# enable adc
CONFIG_ADC=y
```

## drivers/bt81x/Kconfig
```kconfig
# FT8xx Embedded Video Engine configuration options

# Copyright (c) 2020-2021 Hubert Miś <hubert.mis@gmail.com>
# SPDX-License-Identifier: Apache-2.0

config BT81X
	bool "BT81x Embedded Video Engine driver"
	default n
	depends on DT_HAS_BT81X_ENABLED
	select SPI
	help
	  Enable driver for BT81X controller.

config BT81X_INIT_PRIORITY
	int "BT81X init priority"
	default 90
	depends on BT81X
	help
	  BT81X driver initialization priority in POST_KERNEL.


module = BT81X
module-str = bt81x
source "subsys/logging/Kconfig.template.log_config"
```

## dts/bindings/soldetotto/channel.yml
```yaml
# SPDX-License-Identifier: Apache-2.0
title: Solderotto Channel

description: "Solderotto channel: grouping ADC channels and GPIOs for one tool channel"

compatible: "solderotto,channel"

include: base.yaml

properties:
  adc:
    type: phandle
    required: true
    description: ADC controller for this channel

  handle-io-channels:
    type: phandle-array
    specifier-space: io-channel
    required: true
    description: Single IO channel for handle identification (e.g. &adc1 1)

  tip-io-channels:
    type: phandle-array
    specifier-space: io-channel
    required: true
    description: Two IO channels for tip A and tip B (e.g. &adc1 8, &adc1 9)

  load-switch-gpios:
    type: phandle-array
    specifier-space: gpio
    required: true
    description: Two GPIOs controlling load switches for tip A/B

  tip-select-a-gpios:
    type: phandle-array
    specifier-space: gpio
    required: true
    description: Two GPIOs for A-side selector (per tip index)

  tip-select-b-gpios:
    type: phandle-array
    specifier-space: gpio
    required: true
    description: Two GPIOs for B-side selector (per tip index)

  tip-change-gpios:
    type: phandle-array
    specifier-space: gpio
    required: true
    description: GPIO for the tip-change interrupt (1 item)

  stand-idle-gpios:
    type: phandle-array
    specifier-space: gpio
    required: true
    description: GPIO for the stand interrupt (1 item)
```

## dts/bindings/soldetotto/solderotto.yml
```yaml
# SPDX-License-Identifier: Apache-2.0
title: Solderotto Container

description: Logical container node to group Solderotto app properties

compatible: "solderotto,base"

include: base.yaml

properties:
  zcd-gpios:
    type: phandle-array
    specifier-space: gpio
    required: false
    description: Zero-cross detection GPIO (1 item)

  aux-io-channels:
    type: phandle-array
    specifier-space: io-channel
    required: false
    description: Auxiliary ADC channels (e.g. &adc4 3, &adc4 4)
```

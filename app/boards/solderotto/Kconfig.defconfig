## app/boards/solderotto/Kconfig.defconfig
```kconfig
# SPDX-License-Identifier: Apache-2.0

if BOARD_SOLDEROTTO

config SPI_STM32_INTERRUPT
	default y
	depends on SPI

endif
```

## boards/vendor/solderotto/Kconfig.solderotto
```kconfig
# Copyright (c) 2019 Centaur Analytics, Inc
# SPDX-License-Identifier: Apache-2.0

config BOARD_SOLDEROTTO
	select SOC_STM32L496XX
```

## boards/vendor/solderotto/solderotto_defconfig
```kconfig
# SPDX-License-Identifier: Apache-2.0

# Enable MPU
CONFIG_ARM_MPU=y

# Enable HW stack protection
CONFIG_HW_STACK_PROTECTION=y

# enable uart driver
CONFIG_SERIAL=n

# enable GPIOs
CONFIG_GPIO=y

# enable adc
CONFIG_ADC=y

# Enable Clocks
CONFIG_CLOCK_CONTROL=y

# enable pin controller
CONFIG_PINCTRL=y
```

## boards/vendor/solderottov2/Kconfig.solderottov2
```kconfig
# Copyright (c) 2019 STMicroelectronics.
# SPDX-License-Identifier: Apache-2.0

config BOARD_SOLDEROTTOV2
	select SOC_STM32G474XX
```
